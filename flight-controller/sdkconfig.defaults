## flight-controller/sdkconfig.defaults
```kconfig
# Rust often needs a bit of an extra main task stack size compared to C (the default is 3K)
CONFIG_ESP_MAIN_TASK_STACK_SIZE=8000

# Use this to set FreeRTOS kernel tick frequency to 2000 Hz (100 Hz by default).
# This allows to use .5 ms granuality for thread sleeps (10 ms by default).
CONFIG_FREERTOS_HZ=2000

# Workaround for https://github.com/espressif/esp-idf/issues/7631
#CONFIG_MBEDTLS_CERTIFICATE_BUNDLE=n
#CONFIG_MBEDTLS_CERTIFICATE_BUNDLE_DEFAULT_FULL=n

#Disable task watchdog to utilize 100% cpu for flight thread
CONFIG_ESP_TASK_WDT_CHECK_IDLE_TASK_CPU1=n
```
